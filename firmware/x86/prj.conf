## prj.conf
```kconfig
CONFIG_BLUETOOTH=y
CONFIG_BLUETOOTH_DEBUG_LOG=y
CONFIG_BLUETOOTH_SMP=y
CONFIG_BLUETOOTH_PERIPHERAL=y
CONFIG_BLUETOOTH_GATT_DYNAMIC_DB=y
CONFIG_BLUETOOTH_DEVICE_NAME="Test HoG mouse"

#CONFIG_BLUETOOTH_DEBUG_GATT=y
#CONFIG_BLUETOOTH_DEBUG_MONITOR=y
#CONFIG_UART_CONSOLE=n
#CONFIG_UART_QMSI_1_BAUDRATE=1000000
CONFIG_RANDOM_GENERATOR=y
CONFIG_TEST_RANDOM_GENERATOR=y
#CONFIG_TIMER_RANDOM_GENERATOR=y
CONFIG_X86_TSC_RANDOM_GENERATOR=y

CONFIG_PRINTK=y
CONFIG_ARC_INIT=y
CONFIG_IPM=y
CONFIG_IPM_QUARK_SE=y
CONFIG_IPM_QUARK_SE_MASTER=y
CONFIG_IPM_CONSOLE_RECEIVER=y
#CONFIG_TIMESLICE_SIZE=1
#CONFIG_MAIN_STACK_SIZE=2048
```

## src/main.c
```c
#include <zephyr.h>
#include <misc/printk.h>
#include <ipm.h>
#include <ipm/ipm_quark_se.h>

#include "include/ipm_defs.h"

QUARK_SE_IPM_DEFINE(ping_ipm, IPM_CH_PING, QUARK_SE_IPM_OUTBOUND);
QUARK_SE_IPM_DEFINE(pong_ipm, IPM_CH_PONG, QUARK_SE_IPM_INBOUND);
QUARK_SE_IPM_DEFINE(imu_ipm, IPM_CH_IMU, QUARK_SE_IPM_INBOUND);
QUARK_SE_IPM_DEFINE(adc_ipm, IPM_CH_ADC, QUARK_SE_IPM_INBOUND);

static void ipm_init(void);
void imu_ipm_callback(void *ctx, uint32_t id, volatile void *data);

void main(void)
{
	struct device *ipm = device_get_binding("ping_ipm");
	printk("x86 alive!\n");

	// IMC setup
	ipm_init();

	while(1) {
		ipm_send(ipm, IPM_CH_PING, 0, NULL, 0);
		k_sleep(1000);
	}
}

void imu_ipm_callback(void *ctx, uint32_t id, volatile void *data)
{
	printk("IMU message received\n");
#if 0
	uint8_t *counter = (uint8_t *)context;
	char *datac = (char *)data;
	const char *expected;
#endif
}

void adc_ipm_callback(void *ctx, uint32_t id, volatile void *data)
{
	printk("ADC message received\n");
}

void pong_ipm_callback(void *ctx, uint32_t id, volatile void *data)
{
	printk("PONG!\n");
}

static void ipm_init(void)
{
	struct device *ipm;

	/* Register the IPM channels. */
	ipm = device_get_binding("pong_ipm");
	ipm_register_callback(ipm, pong_ipm_callback, NULL);
	ipm_set_enabled(ipm, 1);

	ipm = device_get_binding("imu_ipm");
	ipm_register_callback(ipm, imu_ipm_callback, NULL);
	ipm_set_enabled(ipm, 1);

	ipm = device_get_binding("adc_ipm");
	ipm_register_callback(ipm, adc_ipm_callback, NULL);
	ipm_set_enabled(ipm, 1);


}
 
```

## src/ble.c
```c
#include <zephyr/types.h>
#include <stddef.h>
#include <string.h>
#include <errno.h>
#include <misc/printk.h>
#include <misc/byteorder.h>
#include <zephyr.h>

#include <bluetooth/bluetooth.h>
#include <bluetooth/hci.h>
#include <bluetooth/conn.h>
#include <bluetooth/uuid.h>
#include <bluetooth/gatt.h>

#include <gatt/gap.h>
#include <gatt/dis.h>
#include <gatt/bas.h>
#include <gatt/hog.h>

#define DEVICE_NAME		CONFIG_BLUETOOTH_DEVICE_NAME
#define DEVICE_NAME_LEN		(sizeof(DEVICE_NAME) - 1)
#define HOG_APPEARANCE		0x03c2

static int central_connected = 0;

static const struct bt_data ad[] = {
	BT_DATA_BYTES(BT_DATA_FLAGS, (BT_LE_AD_GENERAL | BT_LE_AD_NO_BREDR)),
	BT_DATA_BYTES(BT_DATA_UUID16_ALL,
		      0x12, 0x18, /* HID Service */
		      0x0f, 0x18), /* Battery Service */
};

static const struct bt_data sd[] = {
	BT_DATA(BT_DATA_NAME_COMPLETE, DEVICE_NAME, DEVICE_NAME_LEN),
};

static void connected(struct bt_conn *conn, u8_t err)
{
	char addr[BT_ADDR_LE_STR_LEN];

	bt_addr_le_to_str(bt_conn_get_dst(conn), addr, sizeof(addr));

	if (err) {
		printk("Failed to connect to %s (%u)\n", addr, err);
		return;
	}
	
	printk("Connected %s\n", addr);

	if (bt_conn_security(conn, BT_SECURITY_MEDIUM)) {
		printk("Failed to set security\n");
	}

}

static void disconnected(struct bt_conn *conn, u8_t reason)
{
	char addr[BT_ADDR_LE_STR_LEN];

	central_connected = 0;
	bt_addr_le_to_str(bt_conn_get_dst(conn), addr, sizeof(addr));

	printk("Disconnected from %s (reason %u)\n", addr, reason);
}

static void security_changed(struct bt_conn *conn, bt_security_t level)
{
	char addr[BT_ADDR_LE_STR_LEN];

	bt_addr_le_to_str(bt_conn_get_dst(conn), addr, sizeof(addr));

	printk("Security changed: %s level %u\n", addr, level);
		central_connected = 1;
}

static struct bt_conn_cb conn_callbacks = {
	.connected = connected,
	.disconnected = disconnected,
	.security_changed = security_changed,
};

static void bt_ready(int err)
{
	if (err) {
		printk("Bluetooth init failed (err %d)\n", err);
		return;
	}

	printk("Bluetooth initialized\n");

	gap_init(DEVICE_NAME, HOG_APPEARANCE);
	bas_init();
	dis_init(CONFIG_SOC, "Waylaid by Jackassery");
	hog_init();

	err = bt_le_adv_start(BT_LE_ADV_CONN, ad, ARRAY_SIZE(ad),
			      sd, ARRAY_SIZE(sd));
	if (err) {
		printk("Advertising failed to start (err %d)\n", err);
		return;
	}

	printk("Advertising successfully started\n");
}

static void auth_passkey_display(struct bt_conn *conn, unsigned int passkey)
{
	char addr[BT_ADDR_LE_STR_LEN];

	bt_addr_le_to_str(bt_conn_get_dst(conn), addr, sizeof(addr));

	printk("Passkey for %s: %u\n", addr, passkey);
}

static void auth_cancel(struct bt_conn *conn)
{
	char addr[BT_ADDR_LE_STR_LEN];

	bt_addr_le_to_str(bt_conn_get_dst(conn), addr, sizeof(addr));

	printk("Pairing cancelled: %s\n", addr);
}

static struct bt_conn_auth_cb auth_cb_display = {
	.passkey_display = auth_passkey_display,
	.passkey_entry = NULL,
	.cancel = auth_cancel,
};

int ble_init(void)
{
    int err;

	err = bt_enable(bt_ready);
	if (err) {
		printk("Bluetooth init failed (err %d)\n", err);
		return err;
	}

	bt_conn_cb_register(&conn_callbacks);
	bt_conn_auth_cb_register(&auth_cb_display);
}
```

## src/ble.h
```c
#ifndef _BLE_H_
#define _BLE_H_

int ble_init(void);

int ble_gatt_report_notify();



#endif
```
