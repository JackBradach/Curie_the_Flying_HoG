## prj.conf
```kconfig
CONFIG_STDOUT_CONSOLE=y
CONFIG_PRINTK=y
CONFIG_IPM=y
CONFIG_IPM_QUARK_SE=y
CONFIG_IPM_CONSOLE_SENDER=y
CONFIG_CONSOLE=y
CONFIG_SERIAL=n
CONFIG_SPI=y
CONFIG_GPIO=y
CONFIG_SENSOR=y
CONFIG_BMI160=y
CONFIG_BMI160_SLAVE=1
CONFIG_BMI160_SPI_BUS_FREQ=88
CONFIG_BMI160_TRIGGER_OWN_THREAD=y
CONFIG_BMI160_TRIGGER=y
```

## src/main.c
```c
#include <ipm.h>
#include <ipm/ipm_quark_se.h>
#include <misc/printk.h>
#include <zephyr.h>

#include "include/ipm_defs.h"
#include "imu.h"
//#include "bmi160.h"

QUARK_SE_IPM_DEFINE(ping_ipm, IPM_CH_PING, QUARK_SE_IPM_INBOUND);
QUARK_SE_IPM_DEFINE(pong_ipm, IPM_CH_PONG, QUARK_SE_IPM_OUTBOUND);
QUARK_SE_IPM_DEFINE(imu_ipm, IPM_CH_IMU, QUARK_SE_IPM_OUTBOUND);
QUARK_SE_IPM_DEFINE(adc_ipm, IPM_CH_ADC, QUARK_SE_IPM_OUTBOUND);

static void ipm_init(void);


void ping_ipm_callback(void *context, u32_t id, volatile void *data)
{
	struct device *ipm;
	int rc;

	ipm = device_get_binding("pong_ipm");
	rc = ipm_send(ipm, 1, 0, NULL, 0);

	ipm = device_get_binding("adc_ipm");
	rc = ipm_send(ipm, 1, 0, NULL, 0);
}


void main(void)
{
	printk("ARC alive!\n");
	ipm_init();
	// Initialize IMU
	imu_start();
//struct device *ipm = device_get_binding("ping_ipm");
	// Initialize 
}


static void ipm_init(void)
{
	struct device *ipm;

	/* Register the IPM channels. */
	ipm = device_get_binding("ping_ipm");
	ipm_register_callback(ipm, ping_ipm_callback, NULL);
	ipm_set_enabled(ipm, 1);
}
 
```

## src/imu.c
```c
#include <zephyr.h>
#include <device.h>
#include <sensor.h>
#include <misc/printk.h>
#include <ipm.h>
#include <ipm/ipm_quark_se.h>

#include "include/ipm_defs.h"

#define STACKSIZE 1024
#define PRIORITY 7

char thread_stacks[1][STACKSIZE];
static struct device *bmi160;

void imu_start(void)
{
	struct sensor_value attr;

	bmi160 = device_get_binding(CONFIG_BMI160_NAME);
	if (!bmi160) {
		printk("Gyro: Device not found.\n");
		return;
	}

	/*
	 * Set accelerometer range to +/- 16G. Since the sensor API needs SI
	 * units, convert the range to m/s^2.
	 */
	sensor_g_to_ms2(16, &attr);

	if (sensor_attr_set(bmi160, SENSOR_CHAN_ACCEL_XYZ,
			    SENSOR_ATTR_FULL_SCALE, &attr) < 0) {
		printk("Cannot set accelerometer range.\n");
		return;
	}

	/*
	 * Set gyro range to +/- 250 degrees/s. Since the sensor API needs SI
	 * units, convert the range to rad/s.
	 */
	sensor_degrees_to_rad(250, &attr);

	if (sensor_attr_set(bmi160, SENSOR_CHAN_GYRO_XYZ,
			    SENSOR_ATTR_FULL_SCALE, &attr) < 0) {
		printk("Cannot set gyro range.\n");
		return;
	}

	printk("IMU's probably online!\n");
}

void imu_thread(void *argle, void *bargle, void *wark)
{
	struct device *ipm;
	int rc;

	ARG_UNUSED(argle);
	ARG_UNUSED(bargle);
	ARG_UNUSED(wark);

	struct sensor_value accel_xyz[3];
	struct sensor_value gyro_xyz[3];

	ipm = device_get_binding("imu_ipm");
	while(1) {

		rc = sensor_channel_get(bmi160, SENSOR_CHAN_GYRO_XYZ, gyro_xyz);
		if (rc) {
			printk("Couldn't read gyro: %d\n", rc);
			continue;
		}
		printk("gyro: x%d y%d z%d\n", gyro_xyz[0].val1, gyro_xyz[1].val1, gyro_xyz[2].val1);

		rc = sensor_channel_get(bmi160, SENSOR_CHAN_ACCEL_XYZ, accel_xyz);
		if (rc) {
			printk("Couldn't read gyro: %d\n", rc);
			continue;
		}
		printk("accel: x%d y%d z%d\n", accel_xyz[0].val1, accel_xyz[1].val1, accel_xyz[2].val1);
		
//		rc = ipm_send(ipm, 1, 0, NULL, 0);
		k_sleep(1000);
	}
}

K_THREAD_DEFINE(thread_imu_id, STACKSIZE, imu_thread,
				NULL, NULL, NULL,
				PRIORITY, 0, K_NO_WAIT);
```

## src/imu.h
```c
#ifndef _IMU_H_
#define _IMU_H_

void imu_start(void);

#endif
```
